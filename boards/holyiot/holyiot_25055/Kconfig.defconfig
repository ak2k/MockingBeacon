## boards/holyiot/holyiot_25055/Kconfig.defconfig
```kconfig
# SPDX-License-Identifier: Apache-2.0

config HW_STACK_PROTECTION
	default ARCH_HAS_STACK_PROTECTION

if BOARD_HOLYIOT_25055

# nRF54L05 storage backend is RRAM, not flash.
config SOC_FLASH_NRF_RRAM
	default y

# RAM power library not available for nRF54L family.
config RAM_POWER_DOWN_LIBRARY
	default n

config RAM_POWER_ADJUST_ON_HEAP_RESIZE
	default n

# Newlib NANO not available for nRF54L; full newlib works.
config NEWLIB_LIBC_NANO
	default n

endif # BOARD_HOLYIOT_25055
```

## boards/holyiot/holyiot_25055/Kconfig.holyiot_25055
```kconfig
# Holyiot 25055 board configuration
# SPDX-License-Identifier: Apache-2.0

config BOARD_HOLYIOT_25055
	select SOC_NRF54L05_CPUAPP if BOARD_HOLYIOT_25055_NRF54L05_CPUAPP
```

## boards/holyiot/holyiot_25055/holyiot_25055_nrf54l05_cpuapp_defconfig
```kconfig
# SPDX-License-Identifier: Apache-2.0

# UART debug console (TXD=P1.04, RXD=P1.05)
CONFIG_SERIAL=y
CONFIG_CONSOLE=y
CONFIG_UART_CONSOLE=y

# GPIO drivers for LEDs, button, buzzer
CONFIG_GPIO=y

# MPU
CONFIG_ARM_MPU=y

# Newlib NANO not available for nRF54L family — full newlib is needed.
# Force =n here in defconfig so the project's prj.conf =y can be overridden
# (Kconfig `default n` would NOT override an explicit =y; defconfig does).
CONFIG_NEWLIB_LIBC_NANO=n

# Note: CONFIG_FLASH_HAS_EXPLICIT_ERASE cannot be set here — it's a
# select-only Kconfig auto-enabled by flash drivers that need explicit
# erase (e.g., SPI NOR). The 25055 has no external flash, only on-chip
# RRAM (FLASH_HAS_NO_EXPLICIT_ERASE only). The resulting Zephyr flash.h
# inline-with-unused-parameter is handled at the project CMakeLists
# level via -Wno-unused-parameter on the CXX target.
```

## boards/nrf54l15dk_nrf54l15_cpuapp.conf
```kconfig
# nRF54L15 board-specific Kconfig overrides
# Merged AFTER prj.conf — only override what's incompatible

# RRAM storage
CONFIG_SOC_FLASH_NRF_RRAM=y

# RAM power library not available for nrf54L
CONFIG_RAM_POWER_DOWN_LIBRARY=n
CONFIG_RAM_POWER_ADJUST_ON_HEAP_RESIZE=n

# Newlib NANO not available for nrf54L (full newlib works fine)
CONFIG_NEWLIB_LIBC_NANO=n
```

## tests/unit/testcase.yaml
```yaml
tests:
  unit.beacon:
    tags: unit
    platform_allow: native_sim
    integration_platforms:
      - native_sim
```
