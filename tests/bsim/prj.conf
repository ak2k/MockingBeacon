## CMakeLists.txt
```
# SPDX-License-Identifier: Apache-2.0
cmake_minimum_required(VERSION 3.20.0)
find_package(Zephyr REQUIRED HINTS $ENV{ZEPHYR_BASE})
project(everytag_bsim_test)

# BabbleSim test framework
add_subdirectory(${ZEPHYR_BASE}/tests/bsim/babblekit babblekit)
target_link_libraries(app PRIVATE babblekit)

zephyr_include_directories(
    ${BSIM_COMPONENTS_PATH}/libUtilv1/src/
    ${BSIM_COMPONENTS_PATH}/libPhyComv1/src/
    ${CMAKE_CURRENT_SOURCE_DIR}/../../src
)

target_sources(app PRIVATE
    src/main.c
    src/advertiser.c
    src/scanner.c
    src/beacon_logic_c_api.cpp
    ../../src/beacon_logic.cpp
)
```

## prj.conf
```kconfig
CONFIG_BT=y
CONFIG_BT_DEVICE_NAME="everytag-test"

CONFIG_BT_BROADCASTER=y
CONFIG_BT_OBSERVER=y
# Use Zephyr open-source BLE controller (NCS SDC is ARM-only, won't work on x86 bsim)
CONFIG_BT_LL_SW_SPLIT=y

CONFIG_CPP=y
CONFIG_STD_CPP20=y
CONFIG_EXTERNAL_LIBCPP=y

CONFIG_ASSERT=y
CONFIG_LOG=y
CONFIG_ARCH_POSIX_TRAP_ON_FATAL=y
```

## src/main.c
```c
/*
 * BabbleSim BLE advertisement test for Everytag beacon
 *
 * Two devices:
 * - Device 0 (advertiser): broadcasts AirTag and FMDN advertisements
 *   using the C++ beacon_logic functions, rotates keys
 * - Device 1 (scanner): receives and verifies the exact advertisement
 *   payload bytes match expected values
 */

#include <zephyr/kernel.h>
#include "bs_tracing.h"
#include "bstests.h"
#include "babblekit/testcase.h"

extern void entrypoint_advertiser(void);
extern void entrypoint_scanner(void);
extern enum bst_result_t bst_result;

static void test_end_cb(void)
{
    if (bst_result != Passed) {
        TEST_PRINT("Test has not passed.");
    }
}

static const struct bst_test_instance entrypoints[] = {
    {
        .test_id = "advertiser",
        .test_delete_f = test_end_cb,
        .test_main_f = entrypoint_advertiser,
    },
    {
        .test_id = "scanner",
        .test_delete_f = test_end_cb,
        .test_main_f = entrypoint_scanner,
    },
    BSTEST_END_MARKER,
};

static struct bst_test_list *install(struct bst_test_list *tests)
{
    return bst_add_tests(tests, entrypoints);
}

bst_test_install_t test_installers[] = {install, NULL};

int main(void)
{
    bst_main();
    return 0;
}
```

## src/advertiser.c
```c
/*
 * Advertiser device: broadcasts 3 different AirTag keys in sequence,
 * simulating key rotation. Uses bt_le_adv_update_data() to change
 * the payload without restarting BLE (avoids bt_disable issues on bsim).
 */

#include <zephyr/kernel.h>
#include <zephyr/bluetooth/bluetooth.h>
#include <zephyr/bluetooth/controller.h>
#include <zephyr/bluetooth/hci.h>
#include <zephyr/logging/log.h>

#include "babblekit/testcase.h"

/* Import C++ functions via extern "C" wrappers */
extern void beacon_derive_mac(const uint8_t *key, uint8_t *mac_out);
extern void beacon_fill_template(const uint8_t *key, uint8_t *tmpl, size_t tmpl_size);

LOG_MODULE_REGISTER(advertiser, LOG_LEVEL_INF);

#define NUM_KEYS 3

/* Three test keys — each produces a different 22-byte payload + 2-bit header */
static const uint8_t test_keys[NUM_KEYS][28] = {
    /* Key 0 */
    {0xA3, 0x7B, 0x1F, 0x42, 0xE8, 0x9D, 0x56, 0xC0, 0x3A, 0x88,
     0x14, 0x6E, 0xF2, 0xD7, 0x93, 0x05, 0xBC, 0x61, 0x4F, 0xAA,
     0x27, 0x8C, 0xE5, 0x30, 0x7D, 0x19, 0xB4, 0x68},
    /* Key 1 */
    {0x55, 0x12, 0xAB, 0xCD, 0xEF, 0x01, 0x23, 0x45, 0x67, 0x89,
     0x0A, 0x0B, 0x0C, 0x0D, 0x0E, 0x0F, 0x10, 0x11, 0x12, 0x13,
     0x14, 0x15, 0x16, 0x17, 0x18, 0x19, 0x1A, 0x1B},
    /* Key 2 */
    {0xFF, 0xEE, 0xDD, 0xCC, 0xBB, 0xAA, 0x99, 0x88, 0x77, 0x66,
     0x55, 0x44, 0x33, 0x22, 0x11, 0x00, 0xFE, 0xDC, 0xBA, 0x98,
     0x76, 0x54, 0x32, 0x10, 0x0F, 0x1E, 0x2D, 0x3C},
};

static uint8_t adv_template[31];
static uint8_t adv_data_store[31];

static const uint8_t template_header[] = {
    0x1e, 0xff, 0x4c, 0x00, 0x12, 0x19, 0x00,
};

static void prepare_key(int idx)
{
    /* Reset template header */
    memcpy(adv_template, template_header, sizeof(template_header));
    memset(adv_template + sizeof(template_header), 0,
           sizeof(adv_template) - sizeof(template_header));

    beacon_fill_template(test_keys[idx], adv_template, sizeof(adv_template));
    memcpy(adv_data_store, adv_template, sizeof(adv_template));
}

void entrypoint_advertiser(void)
{
    int err;

    TEST_START("advertiser");

    /* Set MAC derived from key 0 — same path as real firmware */
    uint8_t mac[6];
    beacon_derive_mac(test_keys[0], mac);
    bt_ctlr_set_public_addr(mac);
    LOG_INF("Set MAC from key 0: %02X:%02X:%02X:%02X:%02X:%02X",
            mac[5], mac[4], mac[3], mac[2], mac[1], mac[0]);

    err = bt_enable(NULL);
    TEST_ASSERT(err == 0, "bt_enable failed (err %d)", err);

    /* Verify MAC was applied */
    bt_addr_le_t addrs[CONFIG_BT_ID_MAX];
    size_t count = CONFIG_BT_ID_MAX;
    bt_id_get(addrs, &count);
    TEST_ASSERT(count > 0, "No BT identities after bt_enable");
    TEST_ASSERT(memcmp(addrs[0].a.val, mac, 6) == 0,
                "bt_ctlr_set_public_addr failed: MAC not applied");
    LOG_INF("MAC verified — bt_ctlr_set_public_addr works");

    /* Prepare and start with key 0 */
    prepare_key(0);

    struct bt_data ad[] = {
        BT_DATA(BT_DATA_MANUFACTURER_DATA, adv_data_store + 2, 29),
    };

    err = bt_le_adv_start(
        BT_LE_ADV_PARAM(BT_LE_ADV_OPT_USE_IDENTITY,
                         BT_GAP_ADV_FAST_INT_MIN_1,
                         BT_GAP_ADV_FAST_INT_MAX_1, NULL),
        ad, ARRAY_SIZE(ad), NULL, 0);
    TEST_ASSERT(err == 0, "adv_start failed (err %d)", err);
    LOG_INF("Broadcasting key 0");

    /* Let key 0 advertise for 200ms */
    k_sleep(K_MSEC(200));

    /* Rotate to key 1 — update payload in place */
    prepare_key(1);
    err = bt_le_adv_update_data(ad, ARRAY_SIZE(ad), NULL, 0);
    TEST_ASSERT(err == 0, "adv_update key 1 failed (err %d)", err);
    LOG_INF("Rotated to key 1");

    k_sleep(K_MSEC(200));

    /* Rotate to key 2 */
    prepare_key(2);
    err = bt_le_adv_update_data(ad, ARRAY_SIZE(ad), NULL, 0);
    TEST_ASSERT(err == 0, "adv_update key 2 failed (err %d)", err);
    LOG_INF("Rotated to key 2");

    /* All 3 keys broadcast — advertiser's job is done.
     * The BLE controller continues advertising autonomously
     * while the scanner verifies the payload. */
    TEST_PASS("advertiser");
}
```

## src/beacon_logic_c_api.cpp
```c
/* C API wrappers for beacon_logic C++ functions */
#include "beacon_logic.hpp"

extern "C" {

void beacon_derive_mac(const uint8_t *key, uint8_t *mac_out)
{
    beacon::derive_mac_from_key(key, mac_out);
}

void beacon_fill_template(const uint8_t *key, uint8_t *tmpl, size_t tmpl_size)
{
    beacon::fill_adv_template(key, tmpl, tmpl_size);
}

} /* extern "C" */
```

## src/scanner.c
```c
/*
 * Scanner device: receives AirTag advertisements and verifies:
 * 1. Apple Offline Finding header present
 * 2. Sees 3 different key payloads (key rotation)
 * 3. Each payload's key bytes and top-2-bits match expected values
 */

#include <zephyr/kernel.h>
#include <zephyr/bluetooth/bluetooth.h>
#include <zephyr/bluetooth/hci.h>
#include <zephyr/logging/log.h>

#include "babblekit/flags.h"
#include "babblekit/testcase.h"

/* Import C++ function via extern "C" wrapper */
extern void beacon_derive_mac(const uint8_t *key, uint8_t *mac_out);

LOG_MODULE_REGISTER(scanner, LOG_LEVEL_INF);

#define NUM_KEYS 3

/* Same test keys as advertiser */
static const uint8_t test_keys[NUM_KEYS][28] = {
    {0xA3, 0x7B, 0x1F, 0x42, 0xE8, 0x9D, 0x56, 0xC0, 0x3A, 0x88,
     0x14, 0x6E, 0xF2, 0xD7, 0x93, 0x05, 0xBC, 0x61, 0x4F, 0xAA,
     0x27, 0x8C, 0xE5, 0x30, 0x7D, 0x19, 0xB4, 0x68},
    {0x55, 0x12, 0xAB, 0xCD, 0xEF, 0x01, 0x23, 0x45, 0x67, 0x89,
     0x0A, 0x0B, 0x0C, 0x0D, 0x0E, 0x0F, 0x10, 0x11, 0x12, 0x13,
     0x14, 0x15, 0x16, 0x17, 0x18, 0x19, 0x1A, 0x1B},
    {0xFF, 0xEE, 0xDD, 0xCC, 0xBB, 0xAA, 0x99, 0x88, 0x77, 0x66,
     0x55, 0x44, 0x33, 0x22, 0x11, 0x00, 0xFE, 0xDC, 0xBA, 0x98,
     0x76, 0x54, 0x32, 0x10, 0x0F, 0x1E, 0x2D, 0x3C},
};

static bool key_seen[NUM_KEYS];
static int keys_verified;
static bool mac_checked;

DEFINE_FLAG(all_keys_verified);

static void device_found(const bt_addr_le_t *addr, int8_t rssi, uint8_t type,
                          struct net_buf_simple *ad)
{
    if (ad->len == 0) {
        return;
    }

    struct net_buf_simple buf;
    net_buf_simple_clone(ad, &buf);

    while (buf.len > 1) {
        uint8_t len = net_buf_simple_pull_u8(&buf);
        if (len == 0 || len > buf.len) {
            break;
        }
        uint8_t ad_type = net_buf_simple_pull_u8(&buf);
        uint8_t data_len = len - 1;

        if (ad_type == BT_DATA_MANUFACTURER_DATA && data_len == 29) {
            const uint8_t *data = buf.data;

            /* Check Apple company ID */
            if (data[0] != 0x4c || data[1] != 0x00) {
                goto next;
            }
            /* Check Offline Finding type */
            if (data[2] != 0x12 || data[3] != 0x19) {
                goto next;
            }

            /* Verify advertiser's MAC matches key-0-derived MAC (first time only) */
            if (!mac_checked) {
                uint8_t expected_mac[6];
                beacon_derive_mac(test_keys[0], expected_mac);
                TEST_ASSERT(memcmp(addr->a.val, expected_mac, 6) == 0,
                            "Advertiser MAC does not match key-derived MAC");
                LOG_INF("Advertiser MAC matches key-derived MAC — "
                        "bt_ctlr_set_public_addr verified over the air");
                mac_checked = true;
            }

            /* Try to match against each expected key */
            const uint8_t *payload_key = &data[5];

            for (int k = 0; k < NUM_KEYS; k++) {
                if (key_seen[k]) {
                    continue;
                }
                if (memcmp(payload_key, &test_keys[k][6], 22) != 0) {
                    continue;
                }

                /* Key bytes match — verify top 2 bits */
                uint8_t expected_bits = test_keys[k][0] >> 6;
                TEST_ASSERT(data[27] == expected_bits,
                            "Key %d: top bits got 0x%02x, expected 0x%02x",
                            k, data[27], expected_bits);

                key_seen[k] = true;
                keys_verified++;
                LOG_INF("Verified key %d (%d/%d) — payload correct",
                        k, keys_verified, NUM_KEYS);

                if (keys_verified >= NUM_KEYS) {
                    SET_FLAG(all_keys_verified);
                }
                break;
            }
        }
next:
        net_buf_simple_pull(&buf, data_len);
    }
}

void entrypoint_scanner(void)
{
    int err;

    TEST_START("scanner");

    err = bt_enable(NULL);
    TEST_ASSERT(err == 0, "bt_enable failed (err %d)", err);

    /* No duplicate filtering — we need to see updated payloads from the same address */
    struct bt_le_scan_param scan_param = {
        .type = BT_LE_SCAN_TYPE_PASSIVE,
        .options = BT_LE_SCAN_OPT_NONE,
        .interval = BT_GAP_SCAN_FAST_INTERVAL,
        .window = BT_GAP_SCAN_FAST_WINDOW,
    };
    err = bt_le_scan_start(&scan_param, device_found);
    TEST_ASSERT(err == 0, "Scan start failed (err %d)", err);

    LOG_INF("Scanning for %d different AirTag key advertisements...", NUM_KEYS);

    WAIT_FOR_FLAG(all_keys_verified);

    LOG_INF("All %d keys verified — key rotation produces correct payloads over the air!",
            NUM_KEYS);
    TEST_PASS_AND_EXIT("scanner");
}
```
