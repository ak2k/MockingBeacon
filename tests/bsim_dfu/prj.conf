## CMakeLists.txt
```
# SPDX-License-Identifier: Apache-2.0
cmake_minimum_required(VERSION 3.20.0)
find_package(Zephyr REQUIRED HINTS $ENV{ZEPHYR_BASE})
project(everytag_bsim_dfu_test)

# BabbleSim test framework
add_subdirectory(${ZEPHYR_BASE}/tests/bsim/babblekit babblekit)
target_link_libraries(app PRIVATE babblekit)

zephyr_include_directories(
    ${BSIM_COMPONENTS_PATH}/libUtilv1/src/
    ${BSIM_COMPONENTS_PATH}/libPhyComv1/src/
)

target_sources(app PRIVATE
    src/main.c
    src/smp_server.c
    src/smp_client.c
)
```

## prj.conf
```kconfig
CONFIG_BT=y
CONFIG_BT_DEVICE_NAME="everytag-dfu-test"

# Server side (device 0): MCUmgr SMP over BLE
CONFIG_BT_PERIPHERAL=y
CONFIG_MCUMGR=y
CONFIG_MCUMGR_TRANSPORT_BT=y
CONFIG_MCUMGR_GRP_OS=y
CONFIG_MCUMGR_GRP_OS_ECHO=y
CONFIG_MCUMGR_SMP_SUPPORT_ORIGINAL_PROTOCOL=y

# Client side (device 1): BLE central + GATT client
CONFIG_BT_CENTRAL=y
CONFIG_BT_OBSERVER=y
CONFIG_BT_GATT_CLIENT=y

# BabbleSim BLE controller
CONFIG_BT_LL_SW_SPLIT=y

# Common
CONFIG_CPP=y
CONFIG_STD_CPP20=y
CONFIG_EXTERNAL_LIBCPP=y
CONFIG_ASSERT=y
CONFIG_LOG=y
CONFIG_ARCH_POSIX_TRAP_ON_FATAL=y

# MCUmgr transport dependencies
CONFIG_NET_BUF=y
CONFIG_ZCBOR=y
```

## boards/nrf52_bsim.overlay
```dts
/* Override: use Zephyr open-source BLE controller instead of NCS SDC */
/ {
	chosen {
		zephyr,bt-hci = &bt_hci_controller;
	};
};

&bt_hci_controller {
	status = "okay";
};

&bt_hci_sdc {
	status = "disabled";
};
```

## src/main.c
```c
/*
 * BabbleSim MCUmgr SMP echo test
 *
 * Device 0 (smp_server): connectable BLE peripheral with MCUmgr SMP service
 * Device 1 (smp_client): connects, sends SMP echo, verifies response
 */

#include <zephyr/kernel.h>
#include "bs_tracing.h"
#include "bstests.h"
#include "babblekit/testcase.h"

extern void entrypoint_smp_server(void);
extern void entrypoint_smp_client(void);
extern enum bst_result_t bst_result;

static void test_end_cb(void)
{
    if (bst_result != Passed) {
        TEST_PRINT("Test has not passed.");
    }
}

static const struct bst_test_instance entrypoints[] = {
    {
        .test_id = "smp_server",
        .test_delete_f = test_end_cb,
        .test_main_f = entrypoint_smp_server,
    },
    {
        .test_id = "smp_client",
        .test_delete_f = test_end_cb,
        .test_main_f = entrypoint_smp_client,
    },
    BSTEST_END_MARKER,
};

static struct bst_test_list *install(struct bst_test_list *tests)
{
    return bst_add_tests(tests, entrypoints);
}

bst_test_install_t test_installers[] = {install, NULL};

int main(void)
{
    bst_main();
    return 0;
}
```

## src/smp_client.c
```c
/*
 * SMP client: connects to the server, discovers the MCUmgr SMP GATT
 * service, sends an SMP echo request, and verifies the response.
 *
 * This validates that the MCUmgr BLE transport works end-to-end
 * over a simulated radio without requiring MCUboot or image uploads.
 */

#include <zephyr/kernel.h>
#include <zephyr/bluetooth/bluetooth.h>
#include <zephyr/bluetooth/conn.h>
#include <zephyr/bluetooth/gatt.h>
#include <zephyr/bluetooth/uuid.h>
#include <zephyr/logging/log.h>

#include "babblekit/flags.h"
#include "babblekit/testcase.h"

LOG_MODULE_REGISTER(smp_client, LOG_LEVEL_INF);

/* MCUmgr SMP service UUID: 8D53DC1D-1DB7-4CD3-868B-8A527460AA84 */
static struct bt_uuid_128 smp_svc_uuid = BT_UUID_INIT_128(
    BT_UUID_128_ENCODE(0x8D53DC1D, 0x1DB7, 0x4CD3, 0x868B, 0x8A527460AA84));

/* MCUmgr SMP characteristic UUID: DA2E7828-FBCE-4E01-AE9E-261174997C48 */
static struct bt_uuid_128 smp_chr_uuid = BT_UUID_INIT_128(
    BT_UUID_128_ENCODE(0xDA2E7828, 0xFBCE, 0x4E01, 0xAE9E, 0x261174997C48));

/*
 * SMP echo request (hand-crafted):
 *   Header (8 bytes): op=2 (write), flags=0, len=8, group=0 (OS), seq=0, id=0 (echo)
 *   CBOR payload (8 bytes): {"d":"test"} = a1 61 64 64 74 65 73 74
 */
static const uint8_t smp_echo_req[] = {
    0x02, 0x00, 0x00, 0x08, 0x00, 0x00, 0x00, 0x00,
    0xa1, 0x61, 0x64, 0x64, 0x74, 0x65, 0x73, 0x74,
};

static struct bt_conn *default_conn;
static uint16_t smp_handle;

DEFINE_FLAG(connected);
DEFINE_FLAG(svc_discovered);
DEFINE_FLAG(subscribed);
DEFINE_FLAG(echo_verified);

/* ---- Connection callbacks ---- */

static void conn_cb(struct bt_conn *conn, uint8_t err)
{
    if (err) {
        TEST_FAIL("Connection failed (err %u)", err);
        return;
    }
    default_conn = bt_conn_ref(conn);
    LOG_INF("Connected");
    SET_FLAG(connected);
}

static void disconn_cb(struct bt_conn *conn, uint8_t reason)
{
    LOG_INF("Disconnected (reason %u)", reason);
    bt_conn_unref(default_conn);
    default_conn = NULL;
}

BT_CONN_CB_DEFINE(conn_cbs) = {
    .connected = conn_cb,
    .disconnected = disconn_cb,
};

/* ---- GATT discovery ---- */

static uint8_t discover_cb(struct bt_conn *conn,
                           const struct bt_gatt_attr *attr,
                           struct bt_gatt_discover_params *params)
{
    if (!attr) {
        LOG_INF("Discovery complete");
        return BT_GATT_ITER_STOP;
    }

    if (bt_uuid_cmp(params->uuid, &smp_svc_uuid.uuid) == 0) {
        LOG_INF("Found SMP service at handle %u", attr->handle);
        /* Now discover the SMP characteristic within this service */
        static struct bt_gatt_discover_params chr_params;
        chr_params.uuid = &smp_chr_uuid.uuid;
        chr_params.start_handle = attr->handle + 1;
        chr_params.end_handle = 0xFFFF;
        chr_params.type = BT_GATT_DISCOVER_CHARACTERISTIC;
        chr_params.func = discover_cb;
        bt_gatt_discover(conn, &chr_params);
        return BT_GATT_ITER_STOP;
    }

    if (bt_uuid_cmp(params->uuid, &smp_chr_uuid.uuid) == 0) {
        /* Value handle is one past the characteristic declaration */
        smp_handle = bt_gatt_attr_value_handle(attr);
        LOG_INF("Found SMP characteristic, value handle %u", smp_handle);
        SET_FLAG(svc_discovered);
        return BT_GATT_ITER_STOP;
    }

    return BT_GATT_ITER_CONTINUE;
}

/* ---- SMP notification handler ---- */

static uint8_t notify_cb(struct bt_conn *conn,
                         struct bt_gatt_subscribe_params *params,
                         const void *data, uint16_t length)
{
    if (!data) {
        LOG_INF("Unsubscribed");
        return BT_GATT_ITER_STOP;
    }

    LOG_INF("SMP response received (%u bytes)", length);

    /* Response = 8-byte SMP header + CBOR payload */
    TEST_ASSERT(length >= 8, "Response too short: %u bytes", length);

    const uint8_t *hdr = data;
    TEST_ASSERT(hdr[0] == 0x03, "Expected op=3 (write response), got %u", hdr[0]);
    TEST_ASSERT(hdr[4] == 0x00 && hdr[5] == 0x00, "Expected group=0 (OS)");
    TEST_ASSERT(hdr[7] == 0x00, "Expected id=0 (echo)");

    /* Verify CBOR payload contains the echoed "test" string */
    uint16_t payload_len = length - 8;
    const uint8_t *cbor = hdr + 8;
    const uint8_t test_str[] = {'t', 'e', 's', 't'};
    bool found = false;
    for (uint16_t i = 0; i + sizeof(test_str) <= payload_len; i++) {
        if (memcmp(cbor + i, test_str, sizeof(test_str)) == 0) {
            found = true;
            break;
        }
    }
    TEST_ASSERT(found, "Echo response does not contain 'test' string");

    LOG_INF("SMP echo verified — MCUmgr BLE transport works!");
    SET_FLAG(echo_verified);
    return BT_GATT_ITER_CONTINUE;
}

static struct bt_gatt_subscribe_params sub_params;

static void subscribe_cb(struct bt_conn *conn, uint8_t err,
                         struct bt_gatt_subscribe_params *params)
{
    TEST_ASSERT(err == 0, "Subscribe failed (err %u)", err);
    LOG_INF("Subscribed to SMP notifications");
    SET_FLAG(subscribed);
}

/* ---- Scanner ---- */

static void device_found(const bt_addr_le_t *addr, int8_t rssi, uint8_t type,
                         struct net_buf_simple *ad)
{
    int err;

    if (type != BT_GAP_ADV_TYPE_ADV_IND) {
        return;
    }

    err = bt_le_scan_stop();
    if (err) {
        return;
    }

    struct bt_conn_le_create_param create_param = BT_CONN_LE_CREATE_PARAM_INIT(
        BT_CONN_LE_OPT_NONE, BT_GAP_SCAN_FAST_INTERVAL, BT_GAP_SCAN_FAST_WINDOW);
    struct bt_le_conn_param conn_param = *BT_LE_CONN_PARAM_DEFAULT;

    err = bt_conn_le_create(addr, &create_param, &conn_param, &default_conn);
    if (err) {
        TEST_FAIL("Create conn failed (err %d)", err);
    }
}

/* ---- Entry point ---- */

void entrypoint_smp_client(void)
{
    int err;

    TEST_START("smp_client");

    err = bt_enable(NULL);
    TEST_ASSERT(err == 0, "bt_enable failed (err %d)", err);

    /* Scan for the server */
    struct bt_le_scan_param scan_param = {
        .type = BT_LE_SCAN_TYPE_ACTIVE,
        .options = BT_LE_SCAN_OPT_NONE,
        .interval = BT_GAP_SCAN_FAST_INTERVAL,
        .window = BT_GAP_SCAN_FAST_WINDOW,
    };
    err = bt_le_scan_start(&scan_param, device_found);
    TEST_ASSERT(err == 0, "Scan start failed (err %d)", err);
    LOG_INF("Scanning for SMP server...");

    WAIT_FOR_FLAG(connected);

    /* Discover SMP service */
    static struct bt_gatt_discover_params disc_params;
    disc_params.uuid = &smp_svc_uuid.uuid;
    disc_params.start_handle = BT_ATT_FIRST_ATTRIBUTE_HANDLE;
    disc_params.end_handle = BT_ATT_LAST_ATTRIBUTE_HANDLE;
    disc_params.type = BT_GATT_DISCOVER_PRIMARY;
    disc_params.func = discover_cb;

    err = bt_gatt_discover(default_conn, &disc_params);
    TEST_ASSERT(err == 0, "Discovery start failed (err %d)", err);

    WAIT_FOR_FLAG(svc_discovered);

    /* Subscribe to SMP notifications */
    sub_params.value_handle = smp_handle;
    sub_params.ccc_handle = smp_handle + 1; /* CCC descriptor follows value handle */
    sub_params.notify = notify_cb;
    sub_params.subscribe = subscribe_cb;
    sub_params.value = BT_GATT_CCC_NOTIFY;

    err = bt_gatt_subscribe(default_conn, &sub_params);
    TEST_ASSERT(err == 0, "Subscribe failed (err %d)", err);

    WAIT_FOR_FLAG(subscribed);

    /* Send SMP echo request */
    LOG_INF("Sending SMP echo request...");
    err = bt_gatt_write_without_response(default_conn, smp_handle,
                                         smp_echo_req, sizeof(smp_echo_req), false);
    TEST_ASSERT(err == 0, "GATT write failed (err %d)", err);

    WAIT_FOR_FLAG(echo_verified);

    TEST_PASS_AND_EXIT("smp_client");
}
```

## src/smp_server.c
```c
/*
 * SMP server: connectable BLE peripheral with MCUmgr SMP service.
 * The SMP GATT service registers automatically via SYS_INIT when
 * CONFIG_MCUMGR_TRANSPORT_BT=y — no app code needed.
 */

#include <zephyr/kernel.h>
#include <zephyr/bluetooth/bluetooth.h>
#include <zephyr/logging/log.h>

#include "babblekit/testcase.h"

LOG_MODULE_REGISTER(smp_server, LOG_LEVEL_INF);

static const struct bt_data ad[] = {
    BT_DATA_BYTES(BT_DATA_FLAGS, (BT_LE_AD_GENERAL | BT_LE_AD_NO_BREDR)),
    BT_DATA_BYTES(BT_DATA_NAME_COMPLETE, 'D', 'F', 'U'),
};

void entrypoint_smp_server(void)
{
    int err;

    TEST_START("smp_server");

    err = bt_enable(NULL);
    TEST_ASSERT(err == 0, "bt_enable failed (err %d)", err);

    /* Start connectable advertising — SMP GATT service is already registered */
    err = bt_le_adv_start(BT_LE_ADV_CONN_FAST_1, ad, ARRAY_SIZE(ad), NULL, 0);
    TEST_ASSERT(err == 0, "adv_start failed (err %d)", err);

    LOG_INF("SMP server advertising (MCUmgr SMP service auto-registered)");

    /* Server's job is done — MCUmgr handles SMP requests autonomously.
     * Mark as passed and let the sim run until the client finishes. */
    TEST_PASS("smp_server");
}
```
